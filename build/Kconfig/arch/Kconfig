## build/Kconfig/arch/Kconfig
```kconfig
# Load Zephyr Arch Kconfig descriptions.
osource "C:/Users/rcjam/zephyr/arch/rx/Kconfig"
osource "C:/Users/rcjam/zephyr/arch/x86/Kconfig"
osource "C:/Users/rcjam/zephyr/arch/xtensa/Kconfig"
osource "C:/Users/rcjam/zephyr/arch/sparc/Kconfig"
osource "C:/Users/rcjam/zephyr/arch/riscv/Kconfig"
osource "C:/Users/rcjam/zephyr/arch/posix/Kconfig"
osource "C:/Users/rcjam/zephyr/arch/openrisc/Kconfig"
osource "C:/Users/rcjam/zephyr/arch/mips/Kconfig"
osource "C:/Users/rcjam/zephyr/arch/arm64/Kconfig"
osource "C:/Users/rcjam/zephyr/arch/arm/Kconfig"
osource "C:/Users/rcjam/zephyr/arch/arc/Kconfig"
```

## build/Kconfig/boards/Kconfig
```kconfig
# Load Zephyr board Kconfig descriptions.
osource "C:/Users/rcjam/zephyr/boards/raspberrypi/rpi_pico2/Kconfig"
```

## build/Kconfig/boards/Kconfig.defconfig
```kconfig
# Load Zephyr board defconfig descriptions.
osource "C:/Users/rcjam/zephyr/boards/raspberrypi/rpi_pico2/Kconfig.defconfig"
```

## build/Kconfig/boards/Kconfig.rpi_pico2
```kconfig
# Load board Kconfig descriptions.
osource "C:/Users/rcjam/zephyr/boards/raspberrypi/rpi_pico2/Kconfig.rpi_pico2"
```
