## CMakeLists.txt
```
# Minimum CMake version Zephyr requires
cmake_minimum_required(VERSION 3.20.0)

# Pull in the Zephyr build system. This must come before project().
find_package(Zephyr REQUIRED HINTS $ENV{ZEPHYR_BASE})

# Name of this project/application
project(tamper_zephyr)

# Tell Zephyr which source files make up the app
target_sources(app PRIVATE src/main.c)
```

## west.yml
```
manifest:
  remotes:
    - name: zephyrproject-rtos
      url-base: https://github.com/zephyrproject-rtos

  projects:
    - name: zephyr
      remote: zephyrproject-rtos
      revision: v4.1.0
      import:
        name-allowlist:
          - cmsis
          - cmsis_6
          - hal_rpi_pico
          - picolibc
```

## prj.conf
```kconfig
# Console output via printk
CONFIG_PRINTK=y

# GPIO support for the LED and tamper switch
CONFIG_GPIO=y

# Interactive shell subsystem -- lets us register our own "tamper" command
CONFIG_SHELL=y

# shell owns the USB console
CONFIG_SHELL_BACKEND_SERIAL=y
```

## app.overlay
```dts
/*
 * Devicetree overlay for the tamper-response firmware.
 *
 * This file describes OUR custom hardware to Zephyr: the tamper input pin.
 * Zephyr's devicetree already knows about the board's built-in things (like
 * the onboard LED, led0), but it doesn't know we've wired a reed switch to
 * GPIO15. This overlay adds that information so our code can refer to the
 * tamper pin by name instead of hardcoding pin numbers.
 */

/ {
	tamper {
		compatible = "gpio-keys";
		tamper_switch: tamper_switch {
			gpios = <&gpio0 15 (GPIO_ACTIVE_HIGH | GPIO_PULL_UP)>;
			label = "Tamper Switch";
		};
	};
};
```

## src/main.c
```c
/*
 * Tamper-response firmware for the Raspberry Pi Pico 2 (RP2350), Zephyr version.
 * Stage 5 (final): add a custom "tamper" shell command so you can query the
 *                  device interactively over serial.
 *
 *   tamper status  -> reports ARMED or TAMPERED
 *   tamper secret  -> prints the secret bytes (AB..AB when armed, 00..00 wiped)
 *
 * Threads:
 *   - main            : prints "alive" once a second
 *   - heartbeat_thread: slow blink armed, fast blink tampered
 *   - tamper_thread    : watches the reed switch, zeroizes on tamper
 */

#include <zephyr/kernel.h>
#include <zephyr/drivers/gpio.h>
#include <zephyr/sys/atomic.h>
#include <zephyr/shell/shell.h>

/* ---- Devices ---- */
#define LED0_NODE   DT_ALIAS(led0)
#define TAMPER_NODE DT_NODELABEL(tamper_switch)
static const struct gpio_dt_spec led    = GPIO_DT_SPEC_GET(LED0_NODE, gpios);
static const struct gpio_dt_spec tamper = GPIO_DT_SPEC_GET(TAMPER_NODE, gpios);

/* ---- The secret (volatile so the wipe can't be optimized away) ---- */
#define SECRET_LEN 32
static volatile uint8_t secret[SECRET_LEN];

/* ---- Shared state: 0 = armed, 1 = tampered ---- */
static atomic_t tampered = ATOMIC_INIT(0);

static void arm_secret(void)
{
    for (int i = 0; i < SECRET_LEN; i++) {
        secret[i] = 0xAB;
    }
}

static void zeroize_secret(void)
{
    for (int i = 0; i < SECRET_LEN; i++) {
        secret[i] = 0x00;
    }
}

/* ---- Heartbeat thread: LED reflects shared state ---- */
void heartbeat_thread(void)
{
    if (!gpio_is_ready_dt(&led)) {
        printk("heartbeat: LED device not ready!\n");
        return;
    }
    gpio_pin_configure_dt(&led, GPIO_OUTPUT_INACTIVE);

    while (1) {
        gpio_pin_toggle_dt(&led);
        k_msleep(atomic_get(&tampered) ? 80 : 500);
    }
}

/* ---- Tamper-monitor thread ---- */
void tamper_thread(void)
{
    if (!gpio_is_ready_dt(&tamper)) {
        printk("tamper: switch device not ready!\n");
        return;
    }
    gpio_pin_configure_dt(&tamper, GPIO_INPUT);

    arm_secret();
    printk("tamper: monitoring GPIO15 (armed, secret loaded)\n");

    while (1) {
        int val = gpio_pin_get_dt(&tamper);

        if (!atomic_get(&tampered) && val == 1) {
            zeroize_secret();
            atomic_set(&tampered, 1);
            printk("*** TAMPER DETECTED -- secret zeroized ***\n");
        }

        k_msleep(20);
    }
}

K_THREAD_DEFINE(heartbeat_id, 512, heartbeat_thread, NULL, NULL, NULL, 7, 0, 0);
K_THREAD_DEFINE(tamper_id,    512, tamper_thread,    NULL, NULL, NULL, 5, 0, 0);

/* ======================================================================
 * Custom shell command: "tamper"
 * ====================================================================== */

/* Handler for "tamper status" */
static int cmd_tamper_status(const struct shell *sh, size_t argc, char **argv)
{
    if (atomic_get(&tampered)) {
        shell_print(sh, "State: TAMPERED (secret has been zeroized)");
    } else {
        shell_print(sh, "State: ARMED (secret intact)");
    }
    return 0;
}

/* Handler for "tamper secret" -- dumps the secret bytes so you can SEE
 * whether it's intact (AB..) or wiped (00..). Proof of the zeroize, live. */
static int cmd_tamper_secret(const struct shell *sh, size_t argc, char **argv)
{
    shell_print(sh, "Secret bytes:");
    for (int i = 0; i < SECRET_LEN; i++) {
        shell_fprintf(sh, SHELL_NORMAL, "%02X ", secret[i]);
    }
    shell_print(sh, "");   /* newline */
    return 0;
}

/* Build the subcommand set: "status" and "secret" under "tamper". */
SHELL_STATIC_SUBCMD_SET_CREATE(tamper_subcmds,
    SHELL_CMD(status, NULL, "Show armed/tampered state.", cmd_tamper_status),
    SHELL_CMD(secret, NULL, "Dump the secret bytes.",     cmd_tamper_secret),
    SHELL_SUBCMD_SET_END
);

/* Register the top-level "tamper" command with its subcommands. */
SHELL_CMD_REGISTER(tamper, &tamper_subcmds, "Tamper device commands", NULL);

int main(void)
{
    printk("Tamper firmware starting...\n");

    while (1) {
        // printk("alive\n");
        k_msleep(1000);
    }

    return 0;
}
```
